## config/west.yml
```yaml
manifest:
  remotes:
    - name: zmkfirmware
      url-base: https://github.com/zmkfirmware
    - name: carrefinho
      url-base: https://github.com/carrefinho
    - name: caksoylar
      url-base: https://github.com/caksoylar
    - name: alernety
      url-base: https://github.com/alernety
    - name: urob
      url-base: https://github.com/urob
  projects:
    - name: zmk
      remote: caksoylar
      revision: caksoylar/zen-v1+v2
      import: app/west.yml
    - name: zmk-helpers
      remote: urob
      revision: main
    - name: crpd-zmk-module
      remote: alernety
      revision: main
  self:
    path: config
```
